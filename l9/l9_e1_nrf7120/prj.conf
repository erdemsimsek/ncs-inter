## sysbuild.conf
```
# STEP 1.1 - Enable MCUboot 
SB_CONFIG_BOOTLOADER_MCUBOOT=y

# STEP 1.2 - Configure bootloader mode for dual-slot DFU
# SB_CONFIG_MCUBOOT_MODE_SINGLE_APP=y  # Single slot (no DFU from app)
SB_CONFIG_MCUBOOT_MODE_SINGLE_APP=n    # Dual slot (enables DFU from app)

# MCUboot padding partition size (match signing requirement)
SB_CONFIG_PM_MCUBOOT_PAD=0x800
```

## prj.conf
```kconfig
CONFIG_GPIO=y
# Step 5.2 - Enable mcumgr DFU in application
# Enable MCUMGR 
CONFIG_MCUMGR=y

# Enable UART console
CONFIG_CONSOLE=y
CONFIG_UART_CONSOLE=y

# # Enable MCUMGR management for both OS and Images
CONFIG_MCUMGR_GRP_OS=y
CONFIG_MCUMGR_GRP_IMG=y

# Allow console and mcumgr to share the same UART
CONFIG_UART_CONSOLE_MCUMGR=y

# # Configure MCUMGR transport to UART
CONFIG_MCUMGR_TRANSPORT_UART=y
# # Dependencies
# # Configure dependencies for CONFIG_MCUMGR  
CONFIG_NET_BUF=y
CONFIG_ZCBOR=y
CONFIG_CRC=y

# # Configure dependencies for CONFIG_MCUMGR_GRP_IMG  
CONFIG_FLASH=y
CONFIG_IMG_MANAGER=y

# # Configure dependencies for CONFIG_IMG_MANAGER  
CONFIG_STREAM_FLASH=y
CONFIG_FLASH_MAP=y

# # Configure dependencies for CONFIG_MCUMGR_TRANSPORT_UART 
CONFIG_BASE64=y
```

## src/main.c
```c
/*
 * Copyright (c) 2016 Intel Corporation
 *
 * SPDX-License-Identifier: Apache-2.0
 */

#include <zephyr/kernel.h>
#include <zephyr/drivers/gpio.h>

/* 1000 msec = 1 sec */

/* STEP 4.4 - Change LED timing to create a new image for DFU*/
#define SLEEP_TIME_MS   1000

/* The devicetree node identifier for the "led0" alias. */
#define LED0_NODE DT_ALIAS(led0)

/*
 * A build error on this line means your board is unsupported.
 * See the sample documentation for information on how to fix this.
 */
static const struct gpio_dt_spec led = GPIO_DT_SPEC_GET(LED0_NODE, gpios);

int main(void)
{
	int ret;

	if (!device_is_ready(led.port)) {
		return -1;
	}

	ret = gpio_pin_configure_dt(&led, GPIO_OUTPUT_ACTIVE);
	if (ret < 0) {
		return -1;
	}

	size_t counter = 0u;
	while (1) {
		ret = gpio_pin_toggle_dt(&led);
		if (ret < 0) {
			return -1;
		}
		printk("Hello world from the application, counter value is %u \r\n", counter);
		counter++;
		k_msleep(SLEEP_TIME_MS);
	}
}
```
