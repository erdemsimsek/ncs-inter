## prj.conf
```kconfig
CONFIG_GPIO=y
# Step 5.2 - Enable mcumgr DFU in application
# Enable MCUMGR 

# Enable MCUMGR management for both OS and Images

# Configure MCUMGR transport to UART

# Dependencies
# Configure dependencies for CONFIG_MCUMGR  

# Configure dependencies for CONFIG_MCUMGR_GRP_IMG  

# Configure dependencies for CONFIG_IMG_MANAGER  

# Configure dependencies for CONFIG_MCUMGR_TRANSPORT_UART 
```

## src/main.c
```c
/*
 * Copyright (c) 2016 Intel Corporation
 *
 * SPDX-License-Identifier: Apache-2.0
 */

#include <zephyr/kernel.h>
#include <zephyr/drivers/gpio.h>

/* 1000 msec = 1 sec */

/* STEP 4.4 - Change LED timing to create a new image for DFU*/
#define SLEEP_TIME_MS   1000

/* The devicetree node identifier for the "led0" alias. */
#define LED0_NODE DT_ALIAS(led0)

/*
 * A build error on this line means your board is unsupported.
 * See the sample documentation for information on how to fix this.
 */
static const struct gpio_dt_spec led = GPIO_DT_SPEC_GET(LED0_NODE, gpios);

int main(void)
{
	int ret;

	if (!device_is_ready(led.port)) {
		return -1;
	}

	ret = gpio_pin_configure_dt(&led, GPIO_OUTPUT_ACTIVE);
	if (ret < 0) {
		return -1;
	}

	while (1) {
		ret = gpio_pin_toggle_dt(&led);
		if (ret < 0) {
			return -1;
		}
		k_msleep(SLEEP_TIME_MS);
	}
}
```
